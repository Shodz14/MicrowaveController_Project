#include "tm4c123gh6pm.h"
#include "ports.h"

void PortA_Init()
{
	SYSCTL_RCGCGPIO_R |= 0X01;
	while(!(SYSCTL_PRGPIO_R & 0X01)){};
	GPIO_PORTA_LOCK_R = GPIO_LOCK_KEY;
	GPIO_PORTA_CR_R |= 0xFC;

	GPIO_PORTA_DEN_R |= 0xFC;
	GPIO_PORTA_AFSEL_R = 0;
	GPIO_PORTA_PCTL_R = 0;
	GPIO_PORTA_AMSEL_R = 0;
	GPIO_PORTA_DIR_R = 0xFC;
	GPIO_PORTA_DATA_R = 0x00;

}

void PortB_Init()
{
	SYSCTL_RCGCGPIO_R |= 0x02;
	while(!(SYSCTL_PRGPIO_R & 0x02)){};
	GPIO_PORTB_LOCK_R = GPIO_LOCK_KEY;
	GPIO_PORTB_CR_R |= 0xFF;

	GPIO_PORTB_DEN_R |= 0xFF;
	GPIO_PORTB_AFSEL_R = 0;
	GPIO_PORTB_PCTL_R = 0;
	GPIO_PORTB_AMSEL_R = 0;
	GPIO_PORTB_DIR_R |= 0xFF;
	GPIO_PORTB_PUR_R = 0;
}


void PortE_Init()
{
	SYSCTL_RCGCGPIO_R |= 0X10;
	while((SYSCTL_PRGPIO_R & 0X10)==0){};
	GPIO_PORTE_LOCK_R = GPIO_LOCK_KEY;
	GPIO_PORTE_CR_R = 0X3F;

	GPIO_PORTE_DEN_R |= 0X3F;
	GPIO_PORTE_AFSEL_R &= ~0X3F;
	GPIO_PORTE_PCTL_R &= ~0XFFFFFF;
	GPIO_PORTE_AMSEL_R &= ~0X3F;
	GPIO_PORTE_DIR_R = 0X1E;
	GPIO_PORTE_DATA_R = 0X1E;
	GPIO_PORTE_DIR_R = 0X01;
	GPIO_PORTE_PDR_R = 0x1E;
	GPIO_PORTE_PUR_R |= 0X20;
}

void PortF_Init()
{
	SYSCTL_RCGCGPIO_R |= 0X20;
	while(!(SYSCTL_PRGPIO_R & 0X20)){};
	GPIO_PORTF_LOCK_R = GPIO_LOCK_KEY;
	GPIO_PORTF_CR_R = 0X1F;

	GPIO_PORTF_DEN_R |= 0X1F;
	GPIO_PORTF_AFSEL_R &= ~0X1F;
	GPIO_PORTF_PCTL_R &= ~0XFFFFF;
	GPIO_PORTF_AMSEL_R &= ~0X1F;
	GPIO_PORTF_DIR_R |= 0X0E;
	GPIO_PORTF_PUR_R |= 0x11;
	GPIO_PORTF_DATA_R &= ~0X0E;
}

char SW1()
{
	return(GPIO_PORTF_DATA_R & 0X10); //reading SW1
}

char SW2()
{
	return(GPIO_PORTF_DATA_R & 0X01); 
}

char SW3()
{
	return (GPIO_PORTE_DATA_R & 0X20);
}
